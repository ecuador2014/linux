## distro/hexaos/configs/hexaos_automation_ros2_aarch64_defconfig
```kconfig
# HEXAOS - perfil automation, aarch64, libc glibc, ROS 2: yes  (GENERADO por tools/gen-defconfigs.sh)
BR2_aarch64=y
BR2_cortex_a72=y
BR2_LINUX_KERNEL_IMAGE=y
BR2_LINUX_KERNEL_USE_ARCH_DEFAULT_CONFIG=y
BR2_TOOLCHAIN_BUILDROOT_GLIBC=y
BR2_TOOLCHAIN_BUILDROOT_CXX=y
BR2_OPTIMIZE_2=y
BR2_TARGET_GENERIC_HOSTNAME="hexa-automation"
BR2_TARGET_GENERIC_ISSUE="HEXAOS - automation"
BR2_TARGET_GENERIC_ROOT_PASSWD=""
BR2_ROOTFS_DEVICE_CREATION_DYNAMIC_EUDEV=y
BR2_ROOTFS_OVERLAY="$(BR2_EXTERNAL_HEXAOS_PATH)/board/hexaos/overlay-common $(BR2_EXTERNAL_HEXAOS_PATH)/board/hexaos/overlay-automation $(BR2_EXTERNAL_HEXAOS_PATH)/board/hexaos/overlay-ros2"
BR2_ROOTFS_POST_BUILD_SCRIPT="$(BR2_EXTERNAL_HEXAOS_PATH)/board/hexaos/post-build.sh"
BR2_SYSTEM_DHCP="eth0"
BR2_LINUX_KERNEL=y
BR2_LINUX_KERNEL_CUSTOM_VERSION=y
BR2_LINUX_KERNEL_CUSTOM_VERSION_VALUE="6.18.55"
BR2_LINUX_KERNEL_CONFIG_FRAGMENT_FILES="$(BR2_EXTERNAL_HEXAOS_PATH)/board/hexaos/linux-base.fragment $(BR2_EXTERNAL_HEXAOS_PATH)/board/hexaos/linux-automation.fragment"
BR2_PACKAGE_BUSYBOX_WATCHDOG=y
BR2_PACKAGE_BUSYBOX_WATCHDOG_PERIOD=5
BR2_PACKAGE_DROPBEAR=y
BR2_PACKAGE_CHRONY=y
BR2_PACKAGE_IPROUTE2=y
BR2_PACKAGE_ETHTOOL=y
BR2_PACKAGE_IW=y
BR2_PACKAGE_WPA_SUPPLICANT=y
BR2_PACKAGE_HTOP=y
BR2_PACKAGE_CAN_UTILS=y
BR2_PACKAGE_LIBGPIOD=y
BR2_PACKAGE_LIBGPIOD_TOOLS=y
BR2_PACKAGE_I2C_TOOLS=y
BR2_PACKAGE_SPI_TOOLS=y
BR2_PACKAGE_EVTEST=y
BR2_PACKAGE_RT_TESTS=y
BR2_PACKAGE_V4L_UTILS=y
BR2_PACKAGE_PYTHON3=y
BR2_TARGET_ROOTFS_EXT2=y
BR2_TARGET_ROOTFS_EXT2_4=y
BR2_TARGET_ROOTFS_EXT2_SIZE="2G"
BR2_PACKAGE_NFTABLES=y
BR2_PACKAGE_LIBMODBUS=y
BR2_PACKAGE_MOSQUITTO=y
BR2_PACKAGE_MOSQUITTO_BROKER=y
BR2_PACKAGE_OPEN62541=y
BR2_PACKAGE_PYTHON_SERIAL=y
BR2_PACKAGE_SOCAT=y
BR2_PACKAGE_TCPDUMP=y
BR2_PACKAGE_DNSMASQ=y
# Capa ROS 2 (necesita glibc)
BR2_PACKAGE_BASH=y
BR2_PACKAGE_OPENSSL=y
BR2_PACKAGE_LIBYAML=y
BR2_PACKAGE_TINYXML2=y
BR2_PACKAGE_SPDLOG=y
BR2_PACKAGE_EIGEN=y
BR2_PACKAGE_ACL=y
BR2_PACKAGE_PYTHON_NUMPY=y
BR2_PACKAGE_PYTHON_YAML=y
BR2_PACKAGE_PYTHON_SETUPTOOLS=y
BR2_PACKAGE_PYTHON_LXML=y
BR2_PACKAGE_ROS2_RUNTIME=y
BR2_PACKAGE_ROS2_RUNTIME_TARBALL="$(BR2_EXTERNAL_HEXAOS_PATH)/ros2/output/automation_aarch64/ros2-install.tar.gz"
```

## distro/hexaos/configs/hexaos_car_gui_aarch64_defconfig
```kconfig
# HEXAOS - perfil car, aarch64, libc musl, capa: gui  (GENERADO por tools/gen-defconfigs.sh)
BR2_aarch64=y
BR2_cortex_a72=y
BR2_LINUX_KERNEL_IMAGE=y
BR2_LINUX_KERNEL_USE_ARCH_DEFAULT_CONFIG=y
BR2_TOOLCHAIN_BUILDROOT_MUSL=y
BR2_OPTIMIZE_2=y
BR2_TARGET_GENERIC_HOSTNAME="hexa-car"
BR2_TARGET_GENERIC_ISSUE="HEXAOS - car"
BR2_TARGET_GENERIC_ROOT_PASSWD=""
BR2_ROOTFS_DEVICE_CREATION_DYNAMIC_EUDEV=y
BR2_ROOTFS_OVERLAY="$(BR2_EXTERNAL_HEXAOS_PATH)/board/hexaos/overlay-common $(BR2_EXTERNAL_HEXAOS_PATH)/board/hexaos/overlay-car $(BR2_EXTERNAL_HEXAOS_PATH)/board/hexaos/overlay-gui"
BR2_ROOTFS_POST_BUILD_SCRIPT="$(BR2_EXTERNAL_HEXAOS_PATH)/board/hexaos/post-build.sh"
BR2_SYSTEM_DHCP="eth0"
# Cabeceras de la toolchain: serie 6.12 (Buildroot 2025.02 no conoce 6.18); el kernel sigue siendo 6.18.55
BR2_KERNEL_HEADERS_6_12=y
BR2_LINUX_KERNEL=y
BR2_LINUX_KERNEL_CUSTOM_VERSION=y
BR2_LINUX_KERNEL_CUSTOM_VERSION_VALUE="6.18.55"
BR2_LINUX_KERNEL_CONFIG_FRAGMENT_FILES="$(BR2_EXTERNAL_HEXAOS_PATH)/board/hexaos/linux-base.fragment $(BR2_EXTERNAL_HEXAOS_PATH)/board/hexaos/linux-car.fragment $(BR2_EXTERNAL_HEXAOS_PATH)/board/hexaos/linux-gui.fragment"
BR2_PACKAGE_BUSYBOX_WATCHDOG=y
BR2_PACKAGE_BUSYBOX_WATCHDOG_PERIOD=5
BR2_PACKAGE_DROPBEAR=y
BR2_PACKAGE_CHRONY=y
BR2_PACKAGE_IPROUTE2=y
BR2_PACKAGE_ETHTOOL=y
BR2_PACKAGE_IW=y
BR2_PACKAGE_WPA_SUPPLICANT=y
BR2_PACKAGE_HTOP=y
BR2_PACKAGE_CAN_UTILS=y
BR2_PACKAGE_LIBGPIOD=y
BR2_PACKAGE_LIBGPIOD_TOOLS=y
BR2_PACKAGE_I2C_TOOLS=y
BR2_PACKAGE_SPI_TOOLS=y
BR2_PACKAGE_EVTEST=y
BR2_PACKAGE_RT_TESTS=y
BR2_PACKAGE_V4L_UTILS=y
BR2_PACKAGE_PYTHON3=y
BR2_TARGET_ROOTFS_EXT2=y
BR2_TARGET_ROOTFS_EXT2_4=y
BR2_TARGET_ROOTFS_EXT2_SIZE="768M"
BR2_PACKAGE_LINUXPTP=y
BR2_PACKAGE_GPSD=y
BR2_PACKAGE_TCPDUMP=y
BR2_PACKAGE_LIBPCAP=y
# Capa grafica: kiosco Wayland con Cage (una sola aplicacion a pantalla completa)
BR2_PACKAGE_MESA3D=y
BR2_PACKAGE_MESA3D_OPENGL_EGL=y
BR2_PACKAGE_MESA3D_OPENGL_ES=y
BR2_PACKAGE_MESA3D_GALLIUM_DRIVER_SOFTPIPE=y
BR2_PACKAGE_MESA3D_GALLIUM_DRIVER_VIRGL=y
BR2_PACKAGE_WAYLAND=y
BR2_PACKAGE_CAGE=y
BR2_PACKAGE_FOOT=y
BR2_PACKAGE_SEATD=y
BR2_PACKAGE_SEATD_DAEMON=y
BR2_PACKAGE_LIBINPUT=y
BR2_PACKAGE_XKEYBOARD_CONFIG=y
BR2_PACKAGE_DEJAVU=y
BR2_ROOTFS_USERS_TABLES="$(BR2_EXTERNAL_HEXAOS_PATH)/board/hexaos/gui-users.table"
```

## distro/hexaos/configs/hexaos_car_ros2_x86_64_defconfig
```kconfig
# HEXAOS - perfil car, x86_64, libc glibc, ROS 2: yes  (GENERADO por tools/gen-defconfigs.sh)
BR2_x86_64=y
BR2_LINUX_KERNEL_BZIMAGE=y
BR2_LINUX_KERNEL_USE_ARCH_DEFAULT_CONFIG=y
BR2_TARGET_ROOTFS_CPIO=y
BR2_TARGET_ROOTFS_CPIO_GZIP=y
BR2_TOOLCHAIN_BUILDROOT_GLIBC=y
BR2_TOOLCHAIN_BUILDROOT_CXX=y
BR2_OPTIMIZE_2=y
BR2_TARGET_GENERIC_HOSTNAME="hexa-car"
BR2_TARGET_GENERIC_ISSUE="HEXAOS - car"
BR2_TARGET_GENERIC_ROOT_PASSWD=""
BR2_ROOTFS_DEVICE_CREATION_DYNAMIC_EUDEV=y
BR2_ROOTFS_OVERLAY="$(BR2_EXTERNAL_HEXAOS_PATH)/board/hexaos/overlay-common $(BR2_EXTERNAL_HEXAOS_PATH)/board/hexaos/overlay-car $(BR2_EXTERNAL_HEXAOS_PATH)/board/hexaos/overlay-ros2"
BR2_ROOTFS_POST_BUILD_SCRIPT="$(BR2_EXTERNAL_HEXAOS_PATH)/board/hexaos/post-build.sh"
BR2_SYSTEM_DHCP="eth0"
# Cabeceras de la toolchain: serie 6.12 (Buildroot 2025.02 no conoce 6.18); el kernel sigue siendo 6.18.55
BR2_KERNEL_HEADERS_6_12=y
BR2_LINUX_KERNEL=y
BR2_LINUX_KERNEL_CUSTOM_VERSION=y
BR2_LINUX_KERNEL_CUSTOM_VERSION_VALUE="6.18.55"
BR2_LINUX_KERNEL_CONFIG_FRAGMENT_FILES="$(BR2_EXTERNAL_HEXAOS_PATH)/board/hexaos/linux-base.fragment $(BR2_EXTERNAL_HEXAOS_PATH)/board/hexaos/linux-car.fragment"
BR2_PACKAGE_BUSYBOX_WATCHDOG=y
BR2_PACKAGE_BUSYBOX_WATCHDOG_PERIOD=5
BR2_PACKAGE_DROPBEAR=y
BR2_PACKAGE_CHRONY=y
BR2_PACKAGE_IPROUTE2=y
BR2_PACKAGE_ETHTOOL=y
BR2_PACKAGE_IW=y
BR2_PACKAGE_WPA_SUPPLICANT=y
BR2_PACKAGE_HTOP=y
BR2_PACKAGE_CAN_UTILS=y
BR2_PACKAGE_LIBGPIOD=y
BR2_PACKAGE_LIBGPIOD_TOOLS=y
BR2_PACKAGE_I2C_TOOLS=y
BR2_PACKAGE_SPI_TOOLS=y
BR2_PACKAGE_EVTEST=y
BR2_PACKAGE_RT_TESTS=y
BR2_PACKAGE_V4L_UTILS=y
BR2_PACKAGE_PYTHON3=y
BR2_TARGET_ROOTFS_EXT2=y
BR2_TARGET_ROOTFS_EXT2_4=y
BR2_TARGET_ROOTFS_EXT2_SIZE="2G"
BR2_PACKAGE_LINUXPTP=y
BR2_PACKAGE_GPSD=y
BR2_PACKAGE_TCPDUMP=y
BR2_PACKAGE_LIBPCAP=y
# Capa ROS 2 (necesita glibc)
BR2_PACKAGE_BASH=y
BR2_PACKAGE_OPENSSL=y
BR2_PACKAGE_LIBYAML=y
BR2_PACKAGE_TINYXML2=y
BR2_PACKAGE_SPDLOG=y
BR2_PACKAGE_EIGEN=y
BR2_PACKAGE_ACL=y
BR2_PACKAGE_PYTHON_NUMPY=y
BR2_PACKAGE_PYTHON_YAML=y
BR2_PACKAGE_PYTHON_SETUPTOOLS=y
BR2_PACKAGE_PYTHON_LXML=y
BR2_PACKAGE_ROS2_RUNTIME=y
BR2_PACKAGE_ROS2_RUNTIME_TARBALL="$(BR2_EXTERNAL_HEXAOS_PATH)/ros2/output/car_x86_64/ros2-install.tar.gz"
```

## distro/hexaos/configs/hexaos_drone_rpi4_defconfig
```kconfig
# HEXAOS - perfil drone, rpi4, libc musl, capa: base  (GENERADO por tools/gen-defconfigs.sh)
# Raspberry Pi 4 / 400 / CM4 (aarch64). Basado en raspberrypi4_64_defconfig de Buildroot 2025.02:
# kernel de la fundacion (rama rpi-6.12.y, con PREEMPT_RT), firmware, genimage -> sdcard.img
BR2_aarch64=y
BR2_cortex_a72=y
BR2_ARM_FPU_VFPV4=y
BR2_ROOTFS_POST_IMAGE_SCRIPT="$(BR2_EXTERNAL_HEXAOS_PATH)/board/hexaos/rpi/post-image.sh"
BR2_LINUX_KERNEL_CUSTOM_TARBALL=y
BR2_LINUX_KERNEL_CUSTOM_TARBALL_LOCATION="$(call github,raspberrypi,linux,43c132e8863c3bff3647033b6a7d2bf87b15501c)/linux-43c132e8863c3bff3647033b6a7d2bf87b15501c.tar.gz"
BR2_LINUX_KERNEL_DEFCONFIG="bcm2711"
BR2_LINUX_KERNEL_DTS_SUPPORT=y
BR2_LINUX_KERNEL_INTREE_DTS_NAME="broadcom/bcm2711-rpi-4-b broadcom/bcm2711-rpi-400 broadcom/bcm2711-rpi-cm4 broadcom/bcm2711-rpi-cm4s"
BR2_LINUX_KERNEL_NEEDS_HOST_OPENSSL=y
BR2_PACKAGE_XZ=y
BR2_PACKAGE_KMOD=y
BR2_PACKAGE_KMOD_TOOLS=y
BR2_PACKAGE_RPI_FIRMWARE=y
BR2_PACKAGE_RPI_FIRMWARE_VARIANT_PI4=y
BR2_PACKAGE_RPI_FIRMWARE_INSTALL_DTB_OVERLAYS=y
BR2_PACKAGE_RPI_FIRMWARE_CONFIG_FILE="$(BR2_EXTERNAL_HEXAOS_PATH)/board/hexaos/rpi/config.txt"
BR2_PACKAGE_RPI_FIRMWARE_CMDLINE_FILE="$(BR2_EXTERNAL_HEXAOS_PATH)/board/hexaos/rpi/cmdline.txt"
BR2_PACKAGE_BRCMFMAC_SDIO_FIRMWARE_RPI=y
BR2_PACKAGE_BRCMFMAC_SDIO_FIRMWARE_RPI_WIFI=y
BR2_PACKAGE_BRCMFMAC_SDIO_FIRMWARE_RPI_BT=y
BR2_PACKAGE_HOST_DOSFSTOOLS=y
BR2_PACKAGE_HOST_GENIMAGE=y
BR2_PACKAGE_HOST_KMOD_XZ=y
BR2_PACKAGE_HOST_MTOOLS=y
BR2_TOOLCHAIN_BUILDROOT_MUSL=y
BR2_TOOLCHAIN_BUILDROOT_CXX=y
BR2_OPTIMIZE_2=y
BR2_TARGET_GENERIC_HOSTNAME="hexa-drone"
BR2_TARGET_GENERIC_ISSUE="HEXAOS - drone"
BR2_TARGET_GENERIC_ROOT_PASSWD=""
BR2_ROOTFS_DEVICE_CREATION_DYNAMIC_EUDEV=y
BR2_ROOTFS_OVERLAY="$(BR2_EXTERNAL_HEXAOS_PATH)/board/hexaos/overlay-common $(BR2_EXTERNAL_HEXAOS_PATH)/board/hexaos/overlay-drone"
BR2_ROOTFS_POST_BUILD_SCRIPT="board/raspberrypi4-64/post-build.sh $(BR2_EXTERNAL_HEXAOS_PATH)/board/hexaos/post-build.sh"
BR2_SYSTEM_DHCP="eth0"
# Cabeceras de la toolchain: serie 6.12 (Buildroot 2025.02 no conoce 6.18); el kernel sigue siendo 6.18.55
BR2_KERNEL_HEADERS_6_12=y
BR2_LINUX_KERNEL=y
BR2_LINUX_KERNEL_CONFIG_FRAGMENT_FILES="$(BR2_EXTERNAL_HEXAOS_PATH)/board/hexaos/linux-base.fragment $(BR2_EXTERNAL_HEXAOS_PATH)/board/hexaos/linux-drone.fragment"
BR2_PACKAGE_BUSYBOX_SHOW_OTHERS=y
BR2_PACKAGE_BUSYBOX_WATCHDOG=y
BR2_PACKAGE_BUSYBOX_WATCHDOG_PERIOD="5"
BR2_PACKAGE_DROPBEAR=y
BR2_PACKAGE_CHRONY=y
BR2_PACKAGE_IPROUTE2=y
BR2_PACKAGE_ETHTOOL=y
BR2_PACKAGE_IW=y
BR2_PACKAGE_WPA_SUPPLICANT=y
BR2_PACKAGE_HTOP=y
BR2_PACKAGE_CAN_UTILS=y
BR2_PACKAGE_LIBGPIOD=y
BR2_PACKAGE_LIBGPIOD_TOOLS=y
BR2_PACKAGE_I2C_TOOLS=y
BR2_PACKAGE_SPI_TOOLS=y
BR2_PACKAGE_EVTEST=y
BR2_PACKAGE_RT_TESTS=y
BR2_PACKAGE_LIBV4L=y
BR2_PACKAGE_LIBV4L_UTILS=y
BR2_PACKAGE_PYTHON3=y
BR2_TARGET_ROOTFS_EXT2=y
BR2_TARGET_ROOTFS_EXT2_4=y
BR2_TARGET_ROOTFS_EXT2_SIZE="512M"
BR2_PACKAGE_SOCAT=y
BR2_PACKAGE_GPSD=y
BR2_PACKAGE_GSTREAMER1=y
BR2_PACKAGE_GST1_PLUGINS_BASE=y
BR2_PACKAGE_GST1_PLUGINS_GOOD=y
BR2_PACKAGE_GST1_PLUGINS_GOOD_PLUGIN_V4L2=y
BR2_PACKAGE_GST1_PLUGINS_GOOD_PLUGIN_RTP=y
BR2_PACKAGE_GST1_PLUGINS_GOOD_PLUGIN_UDP=y
```

## distro/hexaos/configs/hexaos_humanoid_x86_64_defconfig
```kconfig
# HEXAOS - perfil humanoid, x86_64, libc musl, ROS 2: no  (GENERADO por tools/gen-defconfigs.sh)
BR2_x86_64=y
BR2_LINUX_KERNEL_BZIMAGE=y
BR2_LINUX_KERNEL_USE_ARCH_DEFAULT_CONFIG=y
BR2_TOOLCHAIN_BUILDROOT_MUSL=y
BR2_OPTIMIZE_2=y
BR2_TARGET_GENERIC_HOSTNAME="hexa-humanoid"
BR2_TARGET_GENERIC_ISSUE="HEXAOS - humanoid"
BR2_TARGET_GENERIC_ROOT_PASSWD=""
BR2_ROOTFS_DEVICE_CREATION_DYNAMIC_EUDEV=y
BR2_ROOTFS_OVERLAY="$(BR2_EXTERNAL_HEXAOS_PATH)/board/hexaos/overlay-common $(BR2_EXTERNAL_HEXAOS_PATH)/board/hexaos/overlay-humanoid"
BR2_ROOTFS_POST_BUILD_SCRIPT="$(BR2_EXTERNAL_HEXAOS_PATH)/board/hexaos/post-build.sh"
BR2_SYSTEM_DHCP="eth0"
# Cabeceras de la toolchain: serie 6.12 (Buildroot 2025.02 no conoce 6.18); el kernel sigue siendo 6.18.55
BR2_KERNEL_HEADERS_6_12=y
BR2_LINUX_KERNEL=y
BR2_LINUX_KERNEL_CUSTOM_VERSION=y
BR2_LINUX_KERNEL_CUSTOM_VERSION_VALUE="6.18.55"
BR2_LINUX_KERNEL_CONFIG_FRAGMENT_FILES="$(BR2_EXTERNAL_HEXAOS_PATH)/board/hexaos/linux-base.fragment $(BR2_EXTERNAL_HEXAOS_PATH)/board/hexaos/linux-humanoid.fragment"
BR2_PACKAGE_BUSYBOX_WATCHDOG=y
BR2_PACKAGE_BUSYBOX_WATCHDOG_PERIOD=5
BR2_PACKAGE_DROPBEAR=y
BR2_PACKAGE_CHRONY=y
BR2_PACKAGE_IPROUTE2=y
BR2_PACKAGE_ETHTOOL=y
BR2_PACKAGE_IW=y
BR2_PACKAGE_WPA_SUPPLICANT=y
BR2_PACKAGE_HTOP=y
BR2_PACKAGE_CAN_UTILS=y
BR2_PACKAGE_LIBGPIOD=y
BR2_PACKAGE_LIBGPIOD_TOOLS=y
BR2_PACKAGE_I2C_TOOLS=y
BR2_PACKAGE_SPI_TOOLS=y
BR2_PACKAGE_EVTEST=y
BR2_PACKAGE_RT_TESTS=y
BR2_PACKAGE_V4L_UTILS=y
BR2_PACKAGE_PYTHON3=y
BR2_TARGET_ROOTFS_EXT2=y
BR2_TARGET_ROOTFS_EXT2_4=y
BR2_TARGET_ROOTFS_EXT2_SIZE="512M"
BR2_PACKAGE_ALSA_UTILS=y
BR2_PACKAGE_ALSA_UTILS_APLAY=y
BR2_PACKAGE_ALSA_UTILS_ARECORD=y
BR2_PACKAGE_ALSA_UTILS_ALSAMIXER=y
```

## distro/hexaos/configs/hexaos_mini_arm_defconfig
```kconfig
# HEXAOS - perfil mini, arm, libc musl, ROS 2: no  (GENERADO por tools/gen-defconfigs.sh)
BR2_arm=y
BR2_cortex_a7=y
BR2_ARM_FPU_NEON_VFPV4=y
BR2_LINUX_KERNEL_ZIMAGE=y
BR2_LINUX_KERNEL_USE_DEFCONFIG=y
BR2_LINUX_KERNEL_DEFCONFIG="multi_v7"
BR2_TOOLCHAIN_BUILDROOT_MUSL=y
BR2_OPTIMIZE_2=y
BR2_TARGET_GENERIC_HOSTNAME="hexa-mini"
BR2_TARGET_GENERIC_ISSUE="HEXAOS - mini"
BR2_TARGET_GENERIC_ROOT_PASSWD=""
BR2_ROOTFS_DEVICE_CREATION_DYNAMIC_EUDEV=y
BR2_ROOTFS_OVERLAY="$(BR2_EXTERNAL_HEXAOS_PATH)/board/hexaos/overlay-common $(BR2_EXTERNAL_HEXAOS_PATH)/board/hexaos/overlay-mini"
BR2_ROOTFS_POST_BUILD_SCRIPT="$(BR2_EXTERNAL_HEXAOS_PATH)/board/hexaos/post-build.sh"
BR2_SYSTEM_DHCP="eth0"
# Cabeceras de la toolchain: serie 6.12 (Buildroot 2025.02 no conoce 6.18); el kernel sigue siendo 6.18.55
BR2_KERNEL_HEADERS_6_12=y
BR2_LINUX_KERNEL=y
BR2_LINUX_KERNEL_CUSTOM_VERSION=y
BR2_LINUX_KERNEL_CUSTOM_VERSION_VALUE="6.18.55"
BR2_LINUX_KERNEL_CONFIG_FRAGMENT_FILES="$(BR2_EXTERNAL_HEXAOS_PATH)/board/hexaos/linux-base.fragment $(BR2_EXTERNAL_HEXAOS_PATH)/board/hexaos/linux-mini.fragment"
BR2_PACKAGE_BUSYBOX_WATCHDOG=y
BR2_PACKAGE_BUSYBOX_WATCHDOG_PERIOD=5
BR2_PACKAGE_DROPBEAR=y
BR2_PACKAGE_CHRONY=y
BR2_PACKAGE_IPROUTE2=y
BR2_PACKAGE_ETHTOOL=y
BR2_PACKAGE_IW=y
BR2_PACKAGE_WPA_SUPPLICANT=y
BR2_PACKAGE_HTOP=y
BR2_PACKAGE_CAN_UTILS=y
BR2_PACKAGE_LIBGPIOD=y
BR2_PACKAGE_LIBGPIOD_TOOLS=y
BR2_PACKAGE_I2C_TOOLS=y
BR2_PACKAGE_SPI_TOOLS=y
BR2_PACKAGE_EVTEST=y
BR2_PACKAGE_RT_TESTS=y
BR2_PACKAGE_V4L_UTILS=y
BR2_PACKAGE_PYTHON3=y
BR2_TARGET_ROOTFS_EXT2=y
BR2_TARGET_ROOTFS_EXT2_4=y
BR2_TARGET_ROOTFS_EXT2_SIZE="128M"
BR2_PACKAGE_PYTHON_SERIAL=y
BR2_PACKAGE_MOSQUITTO=y
BR2_PACKAGE_MOSQUITTO_BROKER=y
BR2_PACKAGE_HOSTAPD=y
BR2_PACKAGE_DNSMASQ=y
BR2_PACKAGE_SOCAT=y
```

## distro/humanoidos/configs/humanoidos_x86_64_defconfig
```kconfig
# HumanoidOS - x86_64 (mini-PC / NUC / QEMU). Toolchain musl, init BusyBox.
BR2_x86_64=y
BR2_TOOLCHAIN_BUILDROOT_MUSL=y
BR2_OPTIMIZE_2=y
BR2_TARGET_GENERIC_HOSTNAME="humanoid"
BR2_TARGET_GENERIC_ISSUE="HumanoidOS - control en tiempo real"
BR2_TARGET_GENERIC_ROOT_PASSWD=""
BR2_ROOTFS_DEVICE_CREATION_DYNAMIC_EUDEV=y
BR2_ROOTFS_OVERLAY="$(BR2_EXTERNAL_HUMANOIDOS_PATH)/board/humanoidos/overlay"
BR2_ROOTFS_POST_BUILD_SCRIPT="$(BR2_EXTERNAL_HUMANOIDOS_PATH)/board/humanoidos/post-build.sh"
BR2_SYSTEM_DHCP="eth0"
# Kernel (PREEMPT_RT mainline desde 6.12)
BR2_LINUX_KERNEL=y
BR2_LINUX_KERNEL_CUSTOM_VERSION=y
BR2_LINUX_KERNEL_CUSTOM_VERSION_VALUE="6.12.20"
BR2_LINUX_KERNEL_USE_ARCH_DEFAULT_CONFIG=y
BR2_LINUX_KERNEL_CONFIG_FRAGMENT_FILES="$(BR2_EXTERNAL_HUMANOIDOS_PATH)/board/humanoidos/linux-robot.fragment"
BR2_LINUX_KERNEL_BZIMAGE=y
# Sistema
BR2_PACKAGE_BUSYBOX_WATCHDOG=y
BR2_PACKAGE_BUSYBOX_WATCHDOG_PERIOD=5
BR2_PACKAGE_DROPBEAR=y
BR2_PACKAGE_CHRONY=y
BR2_PACKAGE_IPROUTE2=y
BR2_PACKAGE_ETHTOOL=y
BR2_PACKAGE_IW=y
BR2_PACKAGE_WPA_SUPPLICANT=y
BR2_PACKAGE_HTOP=y
# Buses de robot: CAN, GPIO, I2C, SPI, input
BR2_PACKAGE_CAN_UTILS=y
BR2_PACKAGE_LIBGPIOD=y
BR2_PACKAGE_LIBGPIOD_TOOLS=y
BR2_PACKAGE_I2C_TOOLS=y
BR2_PACKAGE_SPI_TOOLS=y
BR2_PACKAGE_EVTEST=y
# Diagnostico de latencia RT
BR2_PACKAGE_RT_TESTS=y
# Percepcion / voz
BR2_PACKAGE_V4L_UTILS=y
BR2_PACKAGE_ALSA_UTILS=y
BR2_PACKAGE_ALSA_UTILS_APLAY=y
BR2_PACKAGE_ALSA_UTILS_ARECORD=y
BR2_PACKAGE_ALSA_UTILS_ALSAMIXER=y
# Scripting de alto nivel
BR2_PACKAGE_PYTHON3=y
# Imagen
BR2_TARGET_ROOTFS_EXT2=y
BR2_TARGET_ROOTFS_EXT2_4=y
BR2_TARGET_ROOTFS_EXT2_SIZE="512M"
```

## distro/humanoidos/package/ros2-runtime/Config.in
```kconfig
config BR2_PACKAGE_ROS2_RUNTIME
	bool "ros2-runtime"
	depends on BR2_TOOLCHAIN_USES_GLIBC
	depends on BR2_PACKAGE_PYTHON3
	help
	  Instala en /opt/ros un arbol ROS 2 precompilado
	  (ver ros2/cross-build.sh).

if BR2_PACKAGE_ROS2_RUNTIME

config BR2_PACKAGE_ROS2_RUNTIME_TARBALL
	string "Ruta al tarball del install tree de ROS 2"
	default "$(BR2_EXTERNAL_HUMANOIDOS_PATH)/ros2/output/ros2-install.tar.gz"

endif

comment "ros2-runtime necesita toolchain glibc y python3"
	depends on !BR2_TOOLCHAIN_USES_GLIBC || !BR2_PACKAGE_PYTHON3
```
